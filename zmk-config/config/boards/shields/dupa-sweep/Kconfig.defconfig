## zmk-config/config/boards/shields/dupa-sweep/Kconfig.defconfig
```kconfig
# Copyright (c) 2020 The ZMK Contributors
# SPDX-License-Identifier: MIT

if SHIELD_DUPA_SWEEP_LEFT

config ZMK_KEYBOARD_NAME
	default "DupaSweep"

config ZMK_SPLIT_BLE_ROLE_CENTRAL
	default y

endif

if SHIELD_DUPA_SWEEP_LEFT || SHIELD_DUPA_SWEEP_RIGHT

config ZMK_SPLIT
	default y

endif
```

## zmk-config/config/boards/shields/dupa-sweep/Kconfig.shield
```kconfig
# Copyright (c) 2020 The ZMK Contributors
# SPDX-License-Identifier: MIT

config SHIELD_DUPA_SWEEP_LEFT
	def_bool $(shields_list_contains,dupa_sweep_left)

config SHIELD_DUPA_SWEEP_RIGHT
	def_bool $(shields_list_contains,dupa_sweep_right)
```
